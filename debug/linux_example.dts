/dts-v1/;

/ {
	compatible = "brcm,bcm2835";

	fragment@0 {
		target = <0xffffffff>;

		__overlay__ {
			#address-cells = <0x01>;
			#size-cells = <0x00>;

			spidev@0 {
				compatible = "spidev";
				reg = <0x00>;
				spi-max-frequency = <0x2faf080>;
			};
		};
	};

	fragment@1 {
		target = <0xffffffff>;

		__overlay__ {

			spi0_pins {
				brcm,pins = <0x07 0x08 0x09 0x0a 0x0b>;
				brcm,function = <0x04 0x04 0x04 0x04 0x04>;
				phandle = <0x01>;
			};
		};
	};

	__overrides__ {
		cs0_pin = <0x01 0x6272636d 0x2c70696e 0x733a3000>;
	};

	__symbols__ {
		spi0_pins = "/fragment@1/__overlay__/spi0_pins";
	};

	__fixups__ {
		spi0 = "/fragment@0:target:0";
		gpio = "/fragment@1:target:0";
	};

	__local_fixups__ {

		__overrides__ {
			cs0_pin = <0x00>;
		};
	};
};
