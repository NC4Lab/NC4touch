/dts-v1/;

/ {
	compatible = "brcm,bcm2835";

	fragment@0 {
		target-path = "/";

		__overlay__ {

			ir-receiver@12 {
				compatible = "gpio-ir-receiver";
				pinctrl-names = "default";
				pinctrl-0 = <0x01>;
				gpios = <0xffffffff 0x12 0x01>;
				linux,rc-map-name = "rc-rc6-mce";
				status = "okay";
				phandle = <0x02>;
			};
		};
	};

	fragment@1 {
		target = <0xffffffff>;

		__overlay__ {

			gpio_ir_pins@12 {
				brcm,pins = <0x12>;
				brcm,function = <0x00>;
				brcm,pull = <0x02>;
				phandle = <0x01>;
			};
		};
	};

	__overrides__ {
		gpio_pin = <0x02 0x6770696f 0x733a3400 0x02 0x7265673a 0x30000000 0x16272 0x636d2c70 0x696e733a 0x30000000 0x17265 0x673a3000>;
		gpio_pull = <0x01 0x6272636d 0x2c70756c 0x6c3a3000>;
		invert = <0x02 0x6770696f 0x733a3800>;
		rc-map-name = [00 00 00 02 6c 69 6e 75 78 2c 72 63 2d 6d 61 70 2d 6e 61 6d 65 00];
	};

	__symbols__ {
		gpio_ir = "/fragment@0/__overlay__/ir-receiver@12";
		gpio_ir_pins = "/fragment@1/__overlay__/gpio_ir_pins@12";
	};

	__fixups__ {
		gpio = "/fragment@0/__overlay__/ir-receiver@12:gpios:0\0/fragment@1:target:0";
	};

	__local_fixups__ {

		fragment@0 {

			__overlay__ {

				ir-receiver@12 {
					pinctrl-0 = <0x00>;
				};
			};
		};

		__overrides__ {
			gpio_pin = <0x00 0x0c 0x16 0x26>;
			gpio_pull = <0x00>;
			invert = <0x00>;
			rc-map-name = <0x00>;
		};
	};
};
