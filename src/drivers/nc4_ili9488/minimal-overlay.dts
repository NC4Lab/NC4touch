/dts-v1/;
/plugin/;

/ {
    compatible = "brcm,bcm2835";

    fragment@0 {
        target = <&gpio>;
        __overlay__ {
            gpio-24-output {
                brcm,pins = <24>;
                brcm,function = <1>; /* Set GPIO24 as output */
            };
        };
    };
};
