/dts-v1/;

/ {
	compatible = "brcm,bcm2835";

	fragment@0 {
		target = <0xffffffff>;

		__overlay__ {
			status = "okay";
		};
	};

	fragment@1 {
		target = <0xffffffff>;

		__overlay__ {
			status = "disabled";
		};
	};

	fragment@2 {
		target = <0xffffffff>;

		__overlay__ {

			pitft_pins {
				brcm,pins = <0x16 0x17 0x19>;
				brcm,function = <0x01 0x01 0x01>;
				phandle = <0x01>;
			};
		};
	};

	fragment@3 {
		target = <0xffffffff>;

		__overlay__ {
			#address-cells = <0x01>;
			#size-cells = <0x00>;

			pitft@0 {
				compatible = "ili9488";
				pinctrl-names = "default";
				pinctrl-0 = <0x01>;
				reg = <0x00>;
				spi-max-frequency = <0x7a12000>;
				rotation = <0x00>;
				reset-gpios = <0xffffffff 0x17 0x00>;
				dc-gpios = <0xffffffff 0x19 0x00>;
				backlight = <0x02>;
				phandle = <0x03>;
			};
		};
	};

	fragment@4 {
		target-path = "/soc";

		__overlay__ {

			backlight {
				compatible = "gpio-backlight";
				gpios = <0xffffffff 0x16 0x00>;
				phandle = <0x02>;
			};
		};
	};

	__overrides__ {
		speed = <0x03 0x7370692d 0x6d61782d 0x66726571 0x75656e63 0x793a3000>;
		rotation = [00 00 00 03 72 6f 74 61 74 69 6f 6e 3a 30 00];
	};

	__symbols__ {
		pitft_pins = "/fragment@2/__overlay__/pitft_pins";
		pitft = "/fragment@3/__overlay__/pitft@0";
		backlight = "/fragment@4/__overlay__/backlight";
	};

	__fixups__ {
		spi0 = "/fragment@0:target:0\0/fragment@3:target:0";
		spidev0 = "/fragment@1:target:0";
		gpio = "/fragment@2:target:0\0/fragment@3/__overlay__/pitft@0:reset-gpios:0\0/fragment@3/__overlay__/pitft@0:dc-gpios:0\0/fragment@4/__overlay__/backlight:gpios:0";
	};

	__local_fixups__ {

		fragment@3 {

			__overlay__ {

				pitft@0 {
					pinctrl-0 = <0x00>;
					backlight = <0x00>;
				};
			};
		};

		__overrides__ {
			speed = <0x00>;
			rotation = <0x00>;
		};
	};
};
