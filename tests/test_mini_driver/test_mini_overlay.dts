/dts-v1/;
/plugin/;

/ {
	compatible = "brcm,bcm2835";

	fragment@0 {
		target = <&spi0>;
		__overlay__ {
			status = "okay";

			#address-cells = <1>;
			#size-cells = <0>;

			/* Minimal SPI device node: 'test_mini@0' on CE0 */
			test_mini@0 {
				compatible = "test_mini";
				reg = <0>;       /* use CE0 */
				spi-max-frequency = <1000000>;

				/* No GPIO or other properties for this basic test. */
			};
		};
	};
};

